## ESP32_WIFI/main/Kconfig.projbuild
```kconfig
menu "Home automation OTA"
    config OTA_ENABLE_LEGACY_MQTT
        bool "Preserve original Arduino MQTT OTA wire protocol"
        default y
        help
            Original control/chunk topics have no command authentication or wire session ID.
            Disable in production and use provisioned HMAC requests and v2 chunks.
    config OTA_ALLOW_DEV_HTTP
        bool "Allow plain HTTP for local development"
        default n
        help
            HTTPS certificate verification remains enabled. Enable HTTP only on a trusted development LAN.
    config OTA_BLE_ENABLED
        bool "Enable bonded BLE OTA transport"
        default y
    config OTA_ESPNOW_ENABLED
        bool "Enable provisioned encrypted ESP-NOW transport"
        default y
endmenu
```

## ESP32_WIFI/sdkconfig.defaults
```kconfig
CONFIG_IDF_TARGET="esp32"
CONFIG_ESPTOOLPY_FLASHSIZE_4MB=y
CONFIG_PARTITION_TABLE_CUSTOM=y
CONFIG_PARTITION_TABLE_CUSTOM_FILENAME="partitions.csv"
CONFIG_BOOTLOADER_APP_ROLLBACK_ENABLE=y
CONFIG_BT_ENABLED=y
CONFIG_BT_NIMBLE_ENABLED=y
CONFIG_BT_NIMBLE_NVS_PERSIST=y
CONFIG_BT_NIMBLE_MAX_CONNECTIONS=1
CONFIG_BT_NIMBLE_ATT_PREFERRED_MTU=247
CONFIG_MBEDTLS_CERTIFICATE_BUNDLE=y
CONFIG_ESP_MAIN_TASK_STACK_SIZE=8192
CONFIG_LOG_DEFAULT_LEVEL_INFO=y
CONFIG_COMPILER_OPTIMIZATION_SIZE=y
```
